//---------------------------------------------------------------
#include <EEPROM.h>
//---------------------------------------------------------------
#define MAX_EEPROM_ADDR  512
//---------------------------------------------------------------
void clear(void)
{
  for(int n=0; n<MAX_EEPROM_ADDR; n++)
    EEPROM.write(n, 0);
}
//---------------------------------------------------------------
void print_all(void)
{
  int x, y, n;
  n = 0;
  for(y=0; y<32; y++)
  {
    for(x=0; x<16; x++)
    {
      Serial.print(EEPROM.read(n), DEC);
      Serial.print(" ");
      n++;
    }
    Serial.println("");
  }
}
//---------------------------------------------------------------
void setup(void)
{
  Serial.begin(9600);
  Serial.println("begin");

  //clear();
  print_all();
}
//---------------------------------------------------------------
void loop(void)
{

}
//---------------------------------------------------------------






